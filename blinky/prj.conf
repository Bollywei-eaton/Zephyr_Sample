## CMakeLists.txt
```
# SPDX-License-Identifier: Apache-2.0

cmake_minimum_required(VERSION 3.20.0)
find_package(Zephyr REQUIRED HINTS $ENV{ZEPHYR_BASE})
project(blinky)

add_subdirectory("src" start_app)
```

## prj.conf
```kconfig
CONFIG_GPIO=y
CONFIG_PRINTK=y

CONFIG_HEAP_MEM_POOL_SIZE=256
CONFIG_ASSERT=y
CONFIG_SERIAL=y
CONFIG_UART_INTERRUPT_DRIVEN=y

CONFIG_WATCHDOG=y
CONFIG_WDT_LOG_LEVEL_DBG=y
CONFIG_WDT_DISABLE_AT_BOOT=y

CONFIG_TASK_WDT=y

CONFIG_THREAD_NAME=y

CONFIG_THREAD_RUNTIME_STATS=y
CONFIG_SCHED_THREAD_USAGE=y
CONFIG_SCHED_THREAD_USAGE_ANALYSIS=y

CONFIG_SHELL=y
CONFIG_KERNEL_SHELL=y
CONFIG_DEVICE_SHELL=y
CONFIG_DATE_SHELL=y
CONFIG_STATS=y
CONFIG_STATS_SHELL=y
```

## app.overlay
```dts
/*
 * Copyright (c) 2020 Phytec Messtechnik GmbH
 *
 * SPDX-License-Identifier: Apache-2.0
 */
/ {
	model = "STMicroelectronics STM32F429ZI-NUCLEO board";
	compatible = "st,stm32f429zi-nucleo";

	chosen {
		zephyr,usr-uart = &usart6;
	};
};

&usart6 {
	pinctrl-0 = <&usart6_tx_pg14 &usart6_rx_pg9>;
	pinctrl-names = "default";
	current-speed = <19200>;
	status = "okay";
};
```

## src/main.c
```c
/*
 * Copyright (c) 2016 Intel Corporation
 *
 * SPDX-License-Identifier: Apache-2.0
 */
#include <string.h>
#include <zephyr/zephyr.h>
#include <zephyr/drivers/gpio.h>
#include <zephyr/drivers/watchdog.h>
#include <zephyr/sys/reboot.h>
#include <zephyr/task_wdt/task_wdt.h>
#include "UserTask.h"

/*
 * To use this sample, either the devicetree's /aliases must have a
 * 'watchdog0' property, or one of the following watchdog compatibles
 * must have an enabled node.
 *
 * If the devicetree has a watchdog node, we get the watchdog device
 * from there. Otherwise, the task watchdog will be used without a
 * hardware watchdog fallback.
 */
#if DT_NODE_HAS_STATUS(DT_ALIAS(watchdog0), okay)
#define WDT_NODE DT_ALIAS(watchdog0)
#elif DT_HAS_COMPAT_STATUS_OKAY(st_stm32_window_watchdog)
#define WDT_NODE DT_COMPAT_GET_ANY_STATUS_OKAY(st_stm32_window_watchdog)
#elif DT_HAS_COMPAT_STATUS_OKAY(st_stm32_watchdog)
#define WDT_NODE DT_COMPAT_GET_ANY_STATUS_OKAY(st_stm32_watchdog)
#elif DT_HAS_COMPAT_STATUS_OKAY(nordic_nrf_wdt)
#define WDT_NODE DT_COMPAT_GET_ANY_STATUS_OKAY(nordic_nrf_wdt)
#elif DT_HAS_COMPAT_STATUS_OKAY(espressif_esp32_watchdog)
#define WDT_NODE DT_COMPAT_GET_ANY_STATUS_OKAY(espressif_esp32_watchdog)
#elif DT_HAS_COMPAT_STATUS_OKAY(silabs_gecko_wdog)
#define WDT_NODE DT_COMPAT_GET_ANY_STATUS_OKAY(silabs_gecko_wdog)
#elif DT_HAS_COMPAT_STATUS_OKAY(nxp_kinetis_wdog32)
#define WDT_NODE DT_COMPAT_GET_ANY_STATUS_OKAY(nxp_kinetis_wdog32)
#elif DT_HAS_COMPAT_STATUS_OKAY(microchip_xec_watchdog)
#define WDT_NODE DT_COMPAT_GET_ANY_STATUS_OKAY(microchip_xec_watchdog)
#endif

/* 100 msec = 0.1 sec */
#define SLEEP_TIME_MS   500

/* The devicetree node identifier for the "led1" alias. */
#define LED1_NODE DT_ALIAS(led1)
#if !DT_NODE_HAS_STATUS(LED1_NODE, okay)
#error "Unsupported board: led1 devicetree alias is not defined"
#endif
/* The devicetree node identifier for the "led2" alias. */
#define LED2_NODE DT_ALIAS(led2)
#if !DT_NODE_HAS_STATUS(LED2_NODE, okay)
#error "Unsupported board: led2 devicetree alias is not defined"
#endif
/*
 * A build error on this line means your board is unsupported.
 * See the sample documentation for information on how to fix this.
 */
static const struct led led_1 = {
	.spec = GPIO_DT_SPEC_GET_OR(LED1_NODE, gpios, {0}),
	.gpio_pin_name = DT_PROP_OR(LED1_NODE, label, ""),
};
const struct led led_2 = {
	.spec = GPIO_DT_SPEC_GET_OR(LED2_NODE, gpios, {0}),
	.gpio_pin_name = DT_PROP_OR(LED2_NODE, label, ""),
};

/* The devicetree node identifier for the "sw0" alias. */
#define BUTTON_NODE DT_ALIAS(sw0)
#if !DT_NODE_HAS_STATUS(BUTTON_NODE, okay)
#error "Unsupported board: sw0 devicetree alias is not defined"
#endif

const struct sw sw_0 = {
	.spec = GPIO_DT_SPEC_GET_OR(BUTTON_NODE, gpios, {0}),
	.gpio_pin_name = DT_PROP_OR(BUTTON_NODE, label, ""),
};
static struct gpio_callback button_cb_data;

extern struct k_sem key_sem;


struct k_work_q my_work_q;
struct device_info {
    struct k_work work;
    char name[16];
} my_device;

#define MY_STACK_SIZE 512
#define MY_PRIORITY 5
K_THREAD_STACK_DEFINE(my_stack_area, MY_STACK_SIZE);
struct k_work_q my_work_q;

void button_pressed(const struct device *dev, struct gpio_callback *cb,
		    uint32_t pins)
{
	int ret;
	gpio_pin_toggle(led_2.spec.port, led_2.spec.pin);
	printk("Button pressed at %" PRIu32 "\n", k_cycle_get_32());
	ret = gpio_pin_interrupt_configure_dt(&sw_0.spec,
					      GPIO_INT_DISABLE);						  
	if (ret != 0) {
		printk("Error %d: failed to configure interrupt on %s pin %d\n",
			ret, sw_0.spec.port->name, sw_0.spec.pin);
		return;
	}		
	k_work_submit(&my_device.work);
	k_sem_give(&key_sem);
}

void print_work(struct k_work *item)
{
    struct device_info *the_device =
        CONTAINER_OF(item, struct device_info, work);
    printk("Got a work on device %s\n", the_device->name);
}
	
void main(void)
{	
	int ret;

	printk("Hello World! %s\n", CONFIG_BOARD);
	printk("Lowest task priority is %d\n", K_LOWEST_THREAD_PRIO);
	printk("Highest task priority is %d\n", K_HIGHEST_THREAD_PRIO);
#ifdef WDT_NODE
	const struct device *hw_wdt_dev = DEVICE_DT_GET(WDT_NODE);
#else
	const struct device *hw_wdt_dev = NULL;
#endif

	if (!device_is_ready(hw_wdt_dev)) {
		printk("Hardware watchdog %s is not ready; ignoring it.\n",
		       hw_wdt_dev->name);
		hw_wdt_dev = NULL;
	}

	ret = task_wdt_init(hw_wdt_dev);
	if (ret != 0) {
		printk("task wdt init failure: %d\n", ret);
		return;
	}

	if (!device_is_ready(led_1.spec.port)) {
		printk("Error: %s device is not ready\n", led_1.spec.port->name);
		return;
	}	
	ret = gpio_pin_configure_dt(&led_1.spec, GPIO_OUTPUT_ACTIVE);
	if (ret < 0) {
		printk("Error %d: failed to configure pin %d (LED '%s')\n",
			ret, led_1.spec.pin, led_1.gpio_pin_name);		
		return;
	}
	if (!device_is_ready(led_2.spec.port)) {
		printk("Error: %s device is not ready\n", led_2.spec.port->name);
		return;
	}	
	ret = gpio_pin_configure_dt(&led_2.spec, GPIO_OUTPUT_ACTIVE);
	if (ret < 0) {
		printk("Error %d: failed to configure pin %d (LED '%s')\n",
			ret, led_2.spec.pin, led_2.gpio_pin_name);		
		return;
	}

	if (!device_is_ready(sw_0.spec.port)) {
		printk("Error: %s device is not ready\n", sw_0.spec.port->name);
		return;
	}
	ret = gpio_pin_configure_dt(&sw_0.spec, GPIO_INPUT);
	if (ret < 0) {
		printk("Error %d: failed to configure pin %d (SW '%s')\n",
			ret, sw_0.spec.pin, sw_0.gpio_pin_name);			
		return;
	}	
	ret = gpio_pin_interrupt_configure_dt(&sw_0.spec,
					      GPIO_INT_EDGE_TO_ACTIVE);						  
	if (ret != 0) {
		printk("Error %d: failed to configure interrupt on %s pin %d\n",
			ret, sw_0.spec.port->name, sw_0.spec.pin);
		return;
	}	
	gpio_init_callback(&button_cb_data, button_pressed, BIT(sw_0.spec.pin));
	gpio_add_callback(sw_0.spec.port, &button_cb_data);
	printk("Set up button at %s pin %d\n", sw_0.spec.port->name, sw_0.spec.pin);

	k_work_queue_init(&my_work_q);
	k_work_queue_start(&my_work_q, my_stack_area,
					K_THREAD_STACK_SIZEOF(my_stack_area), MY_PRIORITY,
					NULL);
	/* initialize name info for a device */
	strcpy(my_device.name, "FOO_dev");
	/* initialize work item for printing device's error messages */
	k_work_init(&my_device.work, print_work);

	int task_wdt_id = task_wdt_add(1100U, task_wdt_callback, (void *)k_current_get() );

	while (1) {
		while( gpio_pin_get(sw_0.spec.port, sw_0.spec.pin) )
		{
			
		}
		task_wdt_feed(task_wdt_id);		
		k_msleep(SLEEP_TIME_MS);
	}
}
```

## src/Comm.c
```c
/**
 *****************************************************************************************
 * @file
 * @details See header file for module overview.
 * @copyright 2022 Eaton Corporation. All Rights Reserved.
 *
 *****************************************************************************************
 */
#include <zephyr/zephyr.h>
#include <zephyr/device.h>
#include <zephyr/drivers/uart.h>
#include <string.h>
#include "Comm.h"


/* size of stack area used by each thread */
#define COMM_STACKSIZE 1024

/* scheduling priority used by each thread */
#define COMM_PRIORITY 6

/* change this to any other UART peripheral if desired */
#define UART_DEVICE_NODE DT_CHOSEN(zephyr_usr_uart)

#define MSG_SIZE 32

/* queue to store up to 10 messages (aligned to 4-byte boundary) */
K_MSGQ_DEFINE(uart_msgq, MSG_SIZE, 10, 4);

static const struct device *uart_dev = DEVICE_DT_GET(UART_DEVICE_NODE);

/* receive buffer used in UART ISR callback */
static char rx_buf[MSG_SIZE];
static int rx_buf_pos;

extern struct k_thread _k_thread_obj_blink_id;
/*
 * Read characters from UART until line end is detected. Afterwards push the
 * data to the message queue.
 */
void serial_cb(const struct device *dev, void *user_data)
{
	uint8_t c;

	if (!uart_irq_update(uart_dev)) {
		return;
	}

	while (uart_irq_rx_ready(uart_dev)) {

		uart_fifo_read(uart_dev, &c, 1);

		if ((c == '\n' || c == '\r') && rx_buf_pos > 0) {
			/* terminate string */
			rx_buf[rx_buf_pos] = '\0';

			/* if queue is full, message is silently dropped */
			if( k_msgq_put(&uart_msgq, &rx_buf, K_NO_WAIT) != 0 )
			{
				printk("uart message queue is full\n");
				k_msgq_purge(&uart_msgq);
			}

			/* reset the buffer (it was copied to the msgq) */
			rx_buf_pos = 0;
		} else if (rx_buf_pos < (sizeof(rx_buf) - 1)) {
			rx_buf[rx_buf_pos++] = c;
		}
		/* else: characters beyond buffer size are dropped */
	}
}

/*
 * Print a null-terminated string character by character to the UART interface
 */
void print_uart(char *buf)
{
	int msg_len = strlen(buf);

	for (int i = 0; i < msg_len; i++) {
		uart_poll_out(uart_dev, buf[i]);
	}
}

void comm(void)
{
	char tx_buf[MSG_SIZE];

	printk("comm task is running\n");

	if (!device_is_ready(uart_dev)) {
		printk("UART device not found!");
		return;
	}

	/* configure interrupt and callback to receive data */
	uart_irq_callback_user_data_set(uart_dev, serial_cb, NULL);
	uart_irq_rx_enable(uart_dev);

	print_uart("Hello! I'm your echo bot.\r\n");
	print_uart("Tell me something and press enter:\r\n");

	/* indefinitely wait for input from the user */
	while (k_msgq_get(&uart_msgq, &tx_buf, K_FOREVER) == 0) {
		if( memcmp(tx_buf, "stop", 4) == 0 )
		{
			k_thread_suspend( &_k_thread_obj_blink_id );
			printk("Suspend blink task\n");
		}
		else if( memcmp(tx_buf, "start", 5) == 0 )
		{
			k_thread_resume( &_k_thread_obj_blink_id );
			printk("Resume blink task\n");
		}	
		else if( memcmp(tx_buf, "blink", 5) == 0 )
		{
			k_wakeup( &_k_thread_obj_blink_id );
			printk("Wakeup blink task\n");
		}				
		else
		{
			print_uart("Echo: ");
			print_uart(tx_buf);
			print_uart("\r\n");
		}
	}
}

K_THREAD_DEFINE(comm_id, COMM_STACKSIZE, comm, NULL, NULL, NULL,
		COMM_PRIORITY, 0, 0);	
```

## src/Comm.h
```c
/**
 *****************************************************************************************
 *	@file BLR_IOT_Manager.h
 *
 *	@brief This file contains declarations of BLR IOT manager
 *
 *	@version C++ Style Guide Version 1.0
 *
 *	@copyright 2022 Eaton Corporation. All Rights Reserved.
 *
 *****************************************************************************************
 */

#ifndef __COMM_H__
#define __COMM_H__




#endif  // __COMM_H__
```

## src/UserTask.c
```c
/**
 *****************************************************************************************
 * @file
 * @details See header file for module overview.
 * @copyright 2022 Eaton Corporation. All Rights Reserved.
 *
 *****************************************************************************************
 */
#include <stdlib.h>
#include "UserTask.h"
#include <zephyr/drivers/watchdog.h>
#include <zephyr/shell/shell.h>
#include <zephyr/sys/reboot.h>
#include <zephyr/task_wdt/task_wdt.h>

/* size of stack area used by each thread */
#define BLINK_STACKSIZE 512

/* scheduling priority used by each thread */
#define BLINK_PRIORITY 7

#define SOFT_TIMER_STACKSIZE 512
#define SOFT_TIMER_PRIORITY 7
static struct k_thread soft_timer_thread;

/* The devicetree node identifier for the "led0" alias. */
#define LED0_NODE DT_ALIAS(led0)
#if !DT_NODE_HAS_STATUS(LED0_NODE, okay)
#error "Unsupported board: led0 devicetree alias is not defined"
#endif
static const struct led led_0 = {
	.spec = GPIO_DT_SPEC_GET_OR(LED0_NODE, gpios, {0}),
	.gpio_pin_name = DT_PROP_OR(LED0_NODE, label, ""),
};

struct k_sem key_sem;
extern const struct sw sw_0;
/**************************Static  commands example****************************/
extern const struct led led_2;
static void led_toggle( void )
{
	gpio_pin_toggle(led_2.spec.port, led_2.spec.pin);
	printk("LED2 TOGGLE\n");
}
static void led_on( void )
{
	gpio_pin_set(led_2.spec.port, led_2.spec.pin, 1);
	printk("LED2 ON\n");
}
static void led_off( void )
{
	gpio_pin_set(led_2.spec.port, led_2.spec.pin, 0);
	printk("LED2 OFF\n");
}
SHELL_STATIC_SUBCMD_SET_CREATE(sub_demo,
        SHELL_CMD(toggle, NULL, "led toggle",
                                               led_toggle),
        SHELL_CMD(on,   NULL, "led on", led_on),
		SHELL_CMD(off,   NULL, "led off", led_off),
        SHELL_SUBCMD_SET_END
);
/* Creating root (level 0) command "demo" */
SHELL_CMD_REGISTER(led, &sub_demo, "Control LED", NULL);
/**************************Static  commands example****************************/
/**************************Dictionary commands example****************************/
static int led_flash_freq = 500;
static int gain_cmd_handler(const struct shell *sh,
                            size_t argc, char **argv, void *data)
{
        int freq;

        /* data is a value corresponding to called command syntax */
        freq = (int)data;
        led_flash_freq = 1000 / freq;

        shell_print(sh, "led freq set to: %s, freq is %dHZ\n", argv[0], freq );

        return 0;
}

SHELL_SUBCMD_DICT_SET_CREATE(sub_freq, gain_cmd_handler,
        (freq_1, 1, "freq 1HZ"), (freq_2, 2, "gain 2HZ"),
        (freq_5, 5, "freq 5HZ"), (freq_10, 10, "freq 10HZ")
);
SHELL_CMD_REGISTER(freq, &sub_freq, "Set led freq to 1/2/5/10 HZ", NULL);
/**************************Dictionary commands example****************************/
/**************************Param commands example****************************/
static int chk_data(char *num)
{
    int i;
    for (i = 0; num[i]; i++) // 遍历形参num（传入实参的大小）
    {
        if (num[i] > '9' || num[i] < '0') //只要有非数字，就返回错误
        {
            printk("Invalid input\n");
            return 0;
        }
    }

    if (i > 100) //都是数字，但长度超过100位，返回错误
    {
        printk("Exceed max length\n");
        return 0;
    }
    return 1;
}
static int led2_freq(const struct shell *sh,
                            size_t argc, char **argv)
{
        int freq;
		int cnt;

        printk( "\nargc = %d\n", argc);
        for (cnt = 0; cnt < argc; cnt++) {
                printk( "  argv[%d] = %s\n", cnt, argv[cnt]);
        }
        /* data is a value corresponding to called command syntax */
		if( chk_data( argv[1]) )
		{
			freq = atoi(argv[1]);
			led_flash_freq = 1000 / freq;
			if( led_flash_freq < 10 )
			{
				led_flash_freq = 10;
			}
			printk( "led2 freq is %dHZ\n", freq );
		}      
        return 0;
}

/* Creating subcommands (level 1 command) array for command "demo". */
SHELL_STATIC_SUBCMD_SET_CREATE(sub_demo1,
        SHELL_CMD(freq, NULL, "Set led2 freq command.", led2_freq),
        SHELL_SUBCMD_SET_END
);
/* Creating root (level 0) command "demo" without a handler */
SHELL_CMD_REGISTER(led2, &sub_demo1, "Set led freq to any", NULL);

/**************************Param commands example****************************/

void soft_timer(void)
{
	int ret;

	printk("soft_timer task is running\n");
	k_sem_init(&key_sem, 0, 1);

	while (1) {
		if (k_sem_take(&key_sem, K_FOREVER) == 0) {
			printk("Get key_sem\n");
		}		
		k_msleep(250);
		ret = gpio_pin_interrupt_configure_dt(&sw_0.spec,
							GPIO_INT_EDGE_TO_ACTIVE);						  
		if (ret != 0) {
			printk("Error %d: failed to configure interrupt on %s pin %d\n",
				ret, sw_0.spec.port->name, sw_0.spec.pin);
			return;
		}			
	}
}


void task_wdt_callback(int channel_id, void *user_data)
{
	printk("Task watchdog channel %d callback, thread: %s\n",
		channel_id, k_thread_name_get((k_tid_t)user_data));

	/*
	 * If the issue could be resolved, call task_wdt_feed(channel_id) here
	 * to continue operation.
	 *
	 * Otherwise we can perform some cleanup and reset the device.
	 */

	printk("Resetting device...\n");

	sys_reboot(SYS_REBOOT_COLD);
}

K_THREAD_STACK_DEFINE(soft_timer_event_stack, SOFT_TIMER_STACKSIZE);
void blink(void)
{
	int ret;

	printk("blink task is running\n");

	if (!device_is_ready(led_0.spec.port)) {
		printk("Error: %s device is not ready\n", led_0.spec.port->name);
		return;
	}	
	ret = gpio_pin_configure_dt(&led_0.spec, GPIO_OUTPUT_ACTIVE);
	if (ret < 0) {
		printk("Error %d: failed to configure pin %d (LED '%s')\n",
			ret, led_0.spec.pin, led_0.gpio_pin_name);		
		return;
	}	
	k_tid_t tid = k_thread_create(&soft_timer_thread, soft_timer_event_stack,
			SOFT_TIMER_STACKSIZE,
			(k_thread_entry_t)soft_timer, NULL, NULL, NULL,
			K_PRIO_COOP(SOFT_TIMER_PRIORITY),
			0, K_NO_WAIT);	
	k_thread_name_set(tid, "soft_timer");
	k_thread_start(&soft_timer_thread);
	/*
	 * Add a new task watchdog channel with custom callback function and
	 * the current thread ID as user data.
	 */
	int task_wdt_id = task_wdt_add(1100U, task_wdt_callback,
		(void *)k_current_get());			
	while (1) {
		gpio_pin_toggle(led_0.spec.port, led_0.spec.pin);
		task_wdt_feed(task_wdt_id);
		k_msleep( led_flash_freq );
	}
}

// K_THREAD_DEFINE(blink_id, BLINK_STACKSIZE, blink, NULL, NULL, NULL,
// 		BLINK_PRIORITY, 0, 2000);  //Start running task after 2000ms
K_THREAD_DEFINE(blink_id, BLINK_STACKSIZE, blink, NULL, NULL, NULL,
		BLINK_PRIORITY, 0, 0);			
```

## src/UserTask.h
```c
/**
 *****************************************************************************************
 *	@file BLR_IOT_Manager.h
 *
 *	@brief This file contains declarations of BLR IOT manager
 *
 *	@version C++ Style Guide Version 1.0
 *
 *	@copyright 2022 Eaton Corporation. All Rights Reserved.
 *
 *****************************************************************************************
 */

#ifndef __USER_TASK_H__
#define __USER_TASK_H__
#include <zephyr/zephyr.h>
#include <zephyr/drivers/gpio.h>

struct led {
	struct gpio_dt_spec spec;
	const char *gpio_pin_name;
};

struct sw {
	struct gpio_dt_spec spec;
	const char *gpio_pin_name;
};

void task_wdt_callback(int channel_id, void *user_data);

#endif  // __USER_TASK_H__
```
